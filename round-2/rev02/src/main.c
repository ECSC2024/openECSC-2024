/* Standard includes. */
#include <stdio.h>
#include <string.h>
#include <stdint.h>

/* Hardware library includes. */
#include "hw_memmap.h"
#include "hw_types.h"
#include "hw_sysctl.h"
#include "hw_uart.h"
#include "sysctl.h"
#include "osram128x64x4.h"
#include "uart.h"
#include "coprocessor.h"

/* Constants used when writing strings to the display. */
#define mainCHARACTER_HEIGHT				( 9 )
#define mainMAX_ROWS_128					( mainCHARACTER_HEIGHT * 14 )
#define mainMAX_ROWS_96						( mainCHARACTER_HEIGHT * 10 )
#define mainMAX_ROWS_64						( mainCHARACTER_HEIGHT * 7 )
#define mainFULL_SCALE						( 15 )
#define ulSSI_FREQUENCY						( 3500000UL )

#define FLAG 1

#include "utils.h"

const uint32_t KEY[4] = { 0x22312, 0x5fa32b, 0x5ac810, 0x1337 };
#if FLAG
unsigned char IMAGE[4096] = {0};

char hex2byte(char c1, char c2) {
    char val = 0;
    if (c1 >= '0' && c1 <= '9') c1 = c1 - '0';
    else if (c1 >= 'a' && c1 <='f') c1 = c1 - 'a' + 10;
    else if (c1 >= 'A' && c1 <='F') c1 = c1 - 'A' + 10;
    val = (val << 4) | (c1 & 0xF);
    if (c2 >= '0' && c2 <= '9') c2 = c2 - '0';
    else if (c2 >= 'a' && c2 <='f') c2 = c2 - 'a' + 10;
    else if (c2 >= 'A' && c2 <='F') c2 = c2 - 'A' + 10;
    val = (val << 4) | (c2 & 0xF);
    return val;
}
#else
unsigned char IMAGE[4096] = {
     0x00,0x00,0x00,0x00,0x00,0x00,0x00,0x00,0x00,0x00,0x00,0x00,0x00,0x00,0x00,0x00,0x00,0x00,0x00,0x00,0x00,0x00,0x00,0x00,0x00,0x00,0x00,0x00,0x00,0x00,0x00,0x00,
     0x00,0x00,0x00,0x00,0x00,0x00,0x00,0x00,0x00,0x00,0x00,0x00,0x00,0x00,0x00,0x00,0x00,0x00,0x00,0x00,0x00,0x00,0x00,0x00,0x00,0x00,0x00,0x00,0x00,0x00,0x00,0x00,
     0x00,0x00,0x00,0x00,0x00,0x00,0x00,0x00,0x00,0x00,0x00,0x00,0x00,0x00,0x00,0x00,0x00,0x00,0x00,0x00,0x00,0x00,0x00,0x00,0x00,0x00,0x00,0x00,0x00,0x00,0x00,0x00,
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     0x00,0x00,0x00,0x00,0x00,0x00,0x00,0x00,0x00,0x00,0x00,0x00,0x00,0x00,0x00,0x00,0x00,0x00,0x00,0x00,0x00,0x00,0x00,0x00,0x00,0x00,0x00,0x00,0x00,0x00,0x00,0x00
};
#endif

const char *HEX = "0123456789abcdef";

static void setup(void) {
    SysCtlClockSet( SYSCTL_SYSDIV_4 | SYSCTL_USE_PLL | SYSCTL_OSC_MAIN | SYSCTL_XTAL_8MHZ );
    SysCtlPeripheralEnable( SYSCTL_PERIPH_UART0 );
    UARTEnable( UART0_BASE );
    OSRAM128x64x4Enable(ulSSI_FREQUENCY);
    OSRAM128x64x4Init(ulSSI_FREQUENCY);
    OSRAM128x64x4Clear();

#if FLAG
    for (int i = 0; i < 4096; i++) {
        char c1 = UARTCharGet(UART0_BASE);
        char c2 = UARTCharGet(UART0_BASE);
        IMAGE[i] = hex2byte(c1, c2);
    }
#endif
}

void encrypt(uint32_t *xword, uint32_t *yword)
{
    LOAD_64(*xword, *yword, 0, 0);
    for (int step = 0; step < 10; step++) {
        ADD_KEY(step, 0, step, 0);
        ALZETTE(step, 0, 0, 0);
//#if FLAG == 0
        print(".");
//#endif
    }
    ADD_KEY(0, 0, 0, 0);
    STORE_64((uint32_t)xword, (uint32_t)yword, 0, 0);
}

int main(void) {
    int delay;
    setup();
    OSRAM128x64x4ImageDraw(IMAGE, 0, 0, 128, 64);

    UARTCharPut(UART0_BASE, '>');
    UARTCharGet(UART0_BASE);

    LOAD_KEY(KEY[0],KEY[1],KEY[2],KEY[3]);

    uint32_t *plaintext = (uint32_t*)IMAGE;
    uint32_t iv[2] = {0};
    for (int i = 0; i < 1024; i += 2) {
        delay = 10000000;

        *plaintext ^= iv[0];
        *(plaintext+1) ^= iv[1];
        encrypt(plaintext, plaintext+1);
        iv[0] = *(plaintext++);
        iv[1] = *(plaintext++);

#if FLAG == 0
        while(delay > 0) delay--;
        OSRAM128x64x4ImageDraw(IMAGE, 0, 0, 128, 64);
#endif
    }

    OSRAM128x64x4ImageDraw(IMAGE, 0, 0, 128, 64);

    print(NULL);
    for (int i = 0; i < 4096; i++) {
        UARTCharPut(UART0_BASE, HEX[IMAGE[i] >> 4]);
        UARTCharPut(UART0_BASE, HEX[IMAGE[i] & 0xF]);
    }
    print(NULL);
#if FLAG == 0
    for( ;; );
#endif

}


